## apps/vdc/Kconfig
```kconfig
# SPDX-License-Identifier: GPL-3.0-or-later
#
# Options of the vehicle dynamics controller (VDC) application.

config UNIMOC_VDC_NODE_ID
	int "Node-ID of the VDC"
	default 1
	range 0 255
	help
	  Cyphal node-ID of the VDC; above 127 the node requests one by
	  plug-and-play. The registers of the VDC are not stored yet, so the
	  node-ID comes from the build (native_sim: --node-id=<n> overrides
	  it). The drives have 10 and up (scripts/sim_cluster.sh).

source "Kconfig.zephyr"
```

## boards/unimoc/bcc/Kconfig.bcc
```kconfig
# SPDX-License-Identifier: GPL-3.0-or-later

config BOARD_BCC
	select SOC_STM32G473XX
```

## boards/unimoc/bcc/board.yml
```yaml
# SPDX-License-Identifier: GPL-3.0-or-later

board:
  name: bcc
  full_name: UNIMOC Battery Case Controller
  vendor: unimoc
  socs:
    - name: stm32g473xx
```

## boards/unimoc/jacobi/Kconfig.unimoc_jacobi
```kconfig
# SPDX-License-Identifier: GPL-3.0-or-later

config BOARD_UNIMOC_JACOBI
	select SOC_STM32H743XX
```

## boards/unimoc/jacobi/board.yml
```yaml
# SPDX-License-Identifier: GPL-3.0-or-later

board:
  name: unimoc_jacobi
  full_name: UNIMOC Jacobi (48 V / 50 A drive)
  vendor: unimoc
  socs:
    - name: stm32h743xx
```

## dts/bindings/unimoc,ebike.yaml
```yaml
# SPDX-License-Identifier: GPL-3.0-or-later

description: |
  UNIMOC e-bike inputs of the battery case controller (docs/ebike_plan.md):
  the cadence pulse of the crank torque sensor, the receive line of the
  display, and the UART that transmits to the display.

  The crank torque itself is a channel of the injected ADC sequence (node
  foc0, io-channel "crank-torque").

compatible: "unimoc,ebike"

include: [base.yaml, pinctrl-device.yaml]

properties:
  crank-pulse-gpios:
    type: phandle-array
    required: true
    description: |
      Cadence pulse input of the crank sensor (connector CRANK, PULSE_CRK):
      one falling edge per pole of the sensor ring, with a pull-up on the
      board.

  display-rx-gpios:
    type: phandle-array
    required: true
    description: |
      Receive line of the display (connector Display, DISP_RX). It is on a
      pin without a UART receiver, so the hardware layer captures its edges
      with a timer (timer property) and decodes the bytes in software.

  display-rx-timer:
    type: phandle
    required: true
    description: |
      Timer (st,stm32-timers) whose channel 2 input capture is on the
      display receive pin: TIM15 for PB15. Its interrupt and registers are
      used directly by the hardware layer.

  display-uart:
    type: phandle
    required: true
    description: |
      UART that transmits to the display (connector Display, DISP_TX); its
      receiver is not connected to the display.
```

## dts/bindings/unimoc,foc-stm32g4.yaml
```yaml
# SPDX-License-Identifier: GPL-3.0-or-later

description: |
  UNIMOC three-phase FOC power stage on an STM32G4.

  One PWM timer drives the half bridges. An output compare channel of the
  same timer triggers the injected conversions of the listed ADCs. All pins
  are listed in pinctrl-0, all ADC channels in io-channels.

compatible: "unimoc,foc-stm32g4"

include: [base.yaml, pinctrl-device.yaml]

properties:
  timer:
    type: phandle
    required: true
    description: |
      PWM timer (st,stm32-timers). Its update interrupt and compare registers
      are used directly by the hardware layer.

  dead-time-ns:
    type: int
    required: true
    description: |
      Dead time between the high side and the low side gate signal of each
      half bridge, in nanoseconds. It must cover the turn-off time of the
      MOSFET through its gate resistor plus the delay mismatch of the gate
      driver. The hardware layer rounds it up to the next step the timer can
      generate (6 ns at 170 MHz up to 747 ns, coarser above).

  io-channels:
    type: phandle-array
    required: true
    description: |
      Injected ADC channels in sequence order, two per ADC.

  io-channel-names:
    type: string-array
    required: true
    description: Signal name of each entry in io-channels.

  sample-times:
    type: string-array
    required: true
    description: |
      Sampling time in ADC clock cycles of each entry in io-channels, same
      order. Choose per source impedance: the INA240 current channels settle
      fast and can use short times, resistive dividers and NTCs need longer
      ones. The sum of both ranks sets the length of the injected sequence.
    enum:
      - "2.5"
      - "6.5"
      - "12.5"
      - "24.5"
      - "47.5"
      - "92.5"
      - "247.5"
      - "640.5"
```

## dts/bindings/unimoc,foc-stm32h7.yaml
```yaml
# SPDX-License-Identifier: GPL-3.0-or-later

description: |
  UNIMOC three-phase FOC power stage on an STM32H7 (hardware/zephyr_stm32h7).

  One advanced timer (TIM1 or TIM8) drives the half bridges. Its TRGO2
  output starts the injected sequences of three ADCs at the same instant.
  Each phase current is rank 0 of its own ADC, so the three currents are
  sampled together. All pins are listed in pinctrl-0, all ADC channels in
  io-channels.

  Every entry of io-channels names its signal in io-channel-names: "ia",
  "ib", "ic", "va", "vb", "vc", "vdc", "bridge-temperature" and
  "motor-temperature", each exactly once. The entries of one ADC form its
  injected sequence in devicetree order, one to four conversions. Each phase
  current is on its own ADC and comes first there; the other signals may be
  on any of the three. The end of the sequence of the phase A ADC is the
  sample interrupt, so that sequence must be the longest (checked at build
  time from the sample times).

  The analog front end (shunt, amplifier, dividers) and the limits of the
  power stage are properties of the board.

compatible: "unimoc,foc-stm32h7"

include: [base.yaml, pinctrl-device.yaml]

properties:
  timer:
    type: phandle
    required: true
    description: |
      PWM timer (st,stm32-timers), timers1 or timers8. Its update interrupt
      and compare registers are used directly by the hardware layer.

  dead-time-ns:
    type: int
    required: true
    description: |
      Dead time between the high side and the low side gate signal of each
      half bridge, in nanoseconds. The hardware layer rounds it up to the
      next step the timer can generate (5 ns at 200 MHz up to 635 ns,
      coarser above, at most 5 us).

  current-sense:
    type: string
    default: "inline"
    enum:
      - "inline"
      - "low-side"
    description: |
      Where the phase currents "ia", "ib", "ic" are measured. "inline": a
      shunt or sensor in each phase, valid in every switching state.
      "low-side": a shunt in the source of each low-side switch, valid only
      while that low side conducts. The hardware layer then runs the phases
      in PWM mode 2, so the low-side pulses are centered on the valley
      sample; the control runs after the valleys only (no step every half
      period) and the duty is capped so each low side stays on long enough
      for a sample. The amplifier must give a positive count for a current
      into the motor, as the inline amplifiers do.

  shunt-nano-ohm:
    type: int
    required: true
    description: Resistance of the current shunt of one phase (parallel shunts combined), in nOhm.

  current-amplifier-gain:
    type: int
    required: true
    description: |
      Gain of the current amplifier (INA240A1: 20). Its output is biased to
      half the ADC reference, so a positive count is a current into the motor.

  voltage-divider-ohms:
    type: array
    required: true
    description: |
      Top and bottom resistor of the dividers of Vdc and the phase voltages,
      in Ohm, e.g. <47000 2200>.

  max-phase-current-amps:
    type: int
    required: true
    description: |
      Hard trip limit of the phase current in A (per-sample check in the
      sample interrupt). Must lie inside the range of the current sensing.

  max-motor-current-amps:
    type: int
    required: true
    description: Highest motor current the power stage allows as a setting, in A.

  dc-link-millivolts:
    type: array
    required: true
    description: |
      DC-link limits in mV, <derate trip max>: regenerative braking derates
      from the first value, the drive trips at the second (factory values),
      and no setting may exceed the third (the power stage limit, well below
      the FET rating).

  io-channels:
    type: phandle-array
    required: true
    description: Injected ADC channels; the entries of one ADC are its sequence.

  io-channel-names:
    type: string-array
    required: true
    description: Signal name of each entry in io-channels.

  sample-times:
    type: string-array
    required: true
    description: |
      Sampling time in ADC clock cycles of each entry in io-channels, same
      order (SMPx codes 0 to 7 of the STM32H7 ADC). Low-impedance sources
      such as the INA240 current amplifiers can use short times, resistive
      dividers and NTCs need longer ones.
    enum:
      - "1.5"
      - "2.5"
      - "8.5"
      - "16.5"
      - "32.5"
      - "64.5"
      - "387.5"
      - "810.5"
```

## tests/drive/cart_control/testcase.yaml
```yaml
# SPDX-License-Identifier: GPL-3.0-or-later

common:
  tags: unimoc drive
  platform_allow: native_sim/native/64
  integration_platforms:
    - native_sim/native/64
tests:
  unimoc.drive.cart_control: {}
```

## tests/sim/closed_loop/testcase.yaml
```yaml
# SPDX-License-Identifier: GPL-3.0-or-later

common:
  tags: [unimoc, sim]
  platform_allow: native_sim/native/64
  integration_platforms:
    - native_sim/native/64
tests:
  unimoc.sim.closed_loop: {}
  unimoc.sim.closed_loop.low_side:
    extra_configs:
      - CONFIG_UNIMOC_SIM_LOW_SIDE_CURRENT_SENSE=y
```

## tests/sim/irq_cadence/testcase.yaml
```yaml
# SPDX-License-Identifier: GPL-3.0-or-later

common:
  tags: unimoc sim
  platform_allow: native_sim/native/64
  integration_platforms:
    - native_sim/native/64
tests:
  unimoc.sim.irq_cadence: {}
```

## tests/twister/lib_tests/testcase.yaml
```yaml
# One scenario per lib test source; the lib code is built unchanged.
common:
  harness: gtest
  platform_allow: native_sim/native/64
  tags: unimoc lib
  timeout: 60
tests:
  unimoc.lib.cyphal.control_mode_test:
    extra_args: UNIMOC_TEST_SOURCE=cyphal/tests/control_mode_test.cpp
  unimoc.lib.cyphal.cyphal_interface_test:
    extra_args: UNIMOC_TEST_SOURCE=cyphal/tests/cyphal_interface_test.cpp
  unimoc.lib.cyphal.cyphal_transport_test:
    extra_args: UNIMOC_TEST_SOURCE=cyphal/tests/cyphal_transport_test.cpp
  unimoc.lib.cyphal.node_identity_test:
    extra_args: UNIMOC_TEST_SOURCE=cyphal/tests/node_identity_test.cpp
  unimoc.lib.motor_control.core_control_test:
    extra_args: UNIMOC_TEST_SOURCE=motor_control/tests/core_control_test.cpp
  unimoc.lib.motor_control.excitation_controller_test:
    extra_args: UNIMOC_TEST_SOURCE=motor_control/tests/excitation_controller_test.cpp
  unimoc.lib.motor_control.excitation_observer_test:
    extra_args: UNIMOC_TEST_SOURCE=motor_control/tests/excitation_observer_test.cpp
  unimoc.lib.motor_control.hfi_test:
    extra_args: UNIMOC_TEST_SOURCE=motor_control/tests/hfi_test.cpp
  unimoc.lib.motor_control.position_controller_test:
    extra_args: UNIMOC_TEST_SOURCE=motor_control/tests/position_controller_test.cpp
  unimoc.lib.motor_control.position_tracker_test:
    extra_args: UNIMOC_TEST_SOURCE=motor_control/tests/position_tracker_test.cpp
  unimoc.lib.motor_control.rotor_angle_test:
    extra_args: UNIMOC_TEST_SOURCE=motor_control/tests/rotor_angle_test.cpp
  unimoc.lib.motor_control.rotor_system_test:
    extra_args: UNIMOC_TEST_SOURCE=motor_control/tests/rotor_system_test.cpp
  unimoc.lib.motor_control.sin_cos_test:
    extra_args: UNIMOC_TEST_SOURCE=motor_control/tests/sin_cos_test.cpp
  unimoc.lib.motor_control.stator_system_test:
    extra_args: UNIMOC_TEST_SOURCE=motor_control/tests/stator_system_test.cpp
  unimoc.lib.motor_control.svm_test:
    extra_args: UNIMOC_TEST_SOURCE=motor_control/tests/svm_test.cpp
  unimoc.lib.motor_control.three_phase_system_test:
    extra_args: UNIMOC_TEST_SOURCE=motor_control/tests/three_phase_system_test.cpp
  unimoc.lib.settings.nvm_settings_test:
    extra_args: UNIMOC_TEST_SOURCE=settings/tests/nvm_settings_test.cpp
  unimoc.lib.settings.settings_store_test:
    extra_args: UNIMOC_TEST_SOURCE=settings/tests/settings_store_test.cpp
```
