/*
 * SPDX-License-Identifier: GPL-3.0-or-later
 *
 * Console, shell and log over USB CDC ACM (debug connector J42).
 */

/ {
	chosen {
		zephyr,console = &cdc_acm_uart0;
		zephyr,shell-uart = &cdc_acm_uart0;
	};
};

&zephyr_udc0 {
	cdc_acm_uart0: cdc_acm_uart0 {
		compatible = "zephyr,cdc-acm-uart";
	};
};
