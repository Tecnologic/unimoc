/*
 * SPDX-License-Identifier: GPL-3.0-or-later
 *
 * Settings storage of the simulated drive: 64 KB (16 sectors of 4 KB) in
 * place of the 16 KB of the native_sim board, which no longer hold every
 * register of the drive with the free sector of the ZMS garbage collection
 * (155 registers, docs/motor_thermal_plan.md). The space comes from the
 * MCUboot scratch partition, which native_sim does not use.
 *
 *   0x000de000   72 KB  scratch_partition
 *   0x000f0000   64 KB  storage_partition
 */

&scratch_partition {
	reg = <0x000de000 0x00012000>;
};

&storage_partition {
	reg = <0x000f0000 0x00010000>;
};
