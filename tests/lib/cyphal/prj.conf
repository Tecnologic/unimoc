## CMakeLists.txt
```
# SPDX-License-Identifier: GPL-3.0-or-later
#
# ztest suites of lib/cyphal, run by twister on native_sim.
cmake_minimum_required(VERSION 3.20.0)

find_package(Zephyr REQUIRED HINTS $ENV{ZEPHYR_BASE})
project(unimoc_test_lib_cyphal)

# The UNIMOC module (CONFIG_UNIMOC) declares the library targets.
set(UNIMOC_ROOT ${ZEPHYR_UNIMOC_MODULE_DIR})

file(GLOB test_sources src/*.cpp)
target_sources(app PRIVATE ${test_sources})
target_include_directories(app PRIVATE ${UNIMOC_ROOT}/tests/common)
target_link_libraries(app PRIVATE unimoc_lib)
```

## prj.conf
```kconfig
# SPDX-License-Identifier: GPL-3.0-or-later
CONFIG_ZTEST=y
CONFIG_CPP=y
CONFIG_UNIMOC=y
CONFIG_STD_CPP20=y
CONFIG_REQUIRES_FULL_LIBCPP=y
CONFIG_ZTEST_STACK_SIZE=16384
# Float values in the failure messages of tests/common/unimoc_test.hpp.
CONFIG_CBPRINTF_FP_SUPPORT=y
```

## src/cart_messages_test.cpp
```c
/*
 *       __  ___   ________  _______  ______
 *      / / / / | / /  _/  |/  / __ \/ ____/
 *     / / / /  |/ // // /|_/ / / / / /
 *    / /_/ / /|  // // /  / / / /___
 *    \____/_/ |_/___/_/  /_/\____/\____/
 *
 *    @file cart_messages_test.cpp
 *    @brief ztest coverage for the UNIMOC DSDL messages: one CAN FD frame each, cart message round trips.
 *
 *    SPDX-License-Identifier: GPL-3.0-or-later
 *
 *    This file is part of UNIMOC and is licensed under GPL-3.0-or-later.
 *    See the repository LICENSE file for details.
 */

/**
 * @file cart_messages_test.cpp
 * @brief Frame size of every message of dsdl/unimoc and serialization round trips of the cart messages.
 */
#include <unimoc/cart/BatteryStatus_0_1.h>
#include <unimoc/cart/DriveStatus_0_1.h>
#include <unimoc/cart/PedalState_0_1.h>
#include <unimoc/cart/WheelCommand_0_1.h>
#include <unimoc/drive/CommissioningStatus_0_1.h>
#include <unimoc/drive/CurrentSetpoint_0_1.h>
#include <unimoc/drive/Telemetry_0_1.h>
#include <unimoc/sim/Plant_0_1.h>
#include <zephyr/ztest.h>
#include <array>
#include <cmath>
#include <cstddef>
#include <cstdint>
#include "unimoc_test.hpp"

namespace unimoc::cyphal::test {
namespace {

/// Payload of one CAN FD frame without the tail byte of Cyphal/CAN.
constexpr size_t kCanFdSingleFramePayload = 63U;

// Every message of the UNIMOC namespace fits in one CAN FD frame (docs/system_plan.md, section 4).
static_assert(unimoc_cart_WheelCommand_0_1_SERIALIZATION_BUFFER_SIZE_BYTES_ <= kCanFdSingleFramePayload);
static_assert(unimoc_cart_DriveStatus_0_1_SERIALIZATION_BUFFER_SIZE_BYTES_ <= kCanFdSingleFramePayload);
static_assert(unimoc_cart_PedalState_0_1_SERIALIZATION_BUFFER_SIZE_BYTES_ <= kCanFdSingleFramePayload);
static_assert(unimoc_cart_BatteryStatus_0_1_SERIALIZATION_BUFFER_SIZE_BYTES_ <= kCanFdSingleFramePayload);
static_assert(unimoc_drive_CurrentSetpoint_0_1_SERIALIZATION_BUFFER_SIZE_BYTES_ <= kCanFdSingleFramePayload);
static_assert(unimoc_drive_Telemetry_0_1_SERIALIZATION_BUFFER_SIZE_BYTES_ <= kCanFdSingleFramePayload);
static_assert(unimoc_sim_Plant_0_1_SERIALIZATION_BUFFER_SIZE_BYTES_ <= kCanFdSingleFramePayload);
static_assert(unimoc_drive_CommissioningStatus_0_1_SERIALIZATION_BUFFER_SIZE_BYTES_ <=
              kCanFdSingleFramePayload);
static_assert(unimoc_drive_CommissioningStatus_0_1_EXTENT_BYTES_ == kCanFdSingleFramePayload);

// The cart messages leave room to grow within the frame (@extent): a receiver accepts a longer minor version.
static_assert(unimoc_cart_WheelCommand_0_1_EXTENT_BYTES_ == kCanFdSingleFramePayload);
static_assert(unimoc_cart_DriveStatus_0_1_EXTENT_BYTES_ == kCanFdSingleFramePayload);
static_assert(unimoc_cart_PedalState_0_1_EXTENT_BYTES_ == kCanFdSingleFramePayload);
static_assert(unimoc_cart_BatteryStatus_0_1_EXTENT_BYTES_ == kCanFdSingleFramePayload);

/// Relative resolution of float16 (11 significant bits) with some margin.
constexpr float kFloat16Resolution = 1.0e-3F;

}  // namespace

ZTEST(cart_messages, test_wheel_command_round_trip) {
  unimoc_cart_WheelCommand_0_1 sent{};
  sent.wheel_torque[unimoc_cart_WheelCommand_0_1_WHEEL_FRONT_LEFT] = 12.5F;
  sent.wheel_torque[unimoc_cart_WheelCommand_0_1_WHEEL_FRONT_RIGHT] = 10.25F;
  sent.wheel_torque[unimoc_cart_WheelCommand_0_1_WHEEL_REAR_LEFT] = -30.0F;
  sent.wheel_torque[unimoc_cart_WheelCommand_0_1_WHEEL_REAR_RIGHT] = 0.0F;

  std::array<uint8_t, unimoc_cart_WheelCommand_0_1_SERIALIZATION_BUFFER_SIZE_BYTES_> buffer{};
  size_t size = buffer.size();
  zassert_true(unimoc_cart_WheelCommand_0_1_serialize_(&sent, buffer.data(), &size) >= 0);
  zexpect_equal(size, 8U);

  unimoc_cart_WheelCommand_0_1 received{};
  zassert_true(unimoc_cart_WheelCommand_0_1_deserialize_(&received, buffer.data(), &size) >= 0);
  for (size_t wheel = 0U; wheel < 4U; ++wheel) {
    UNIMOC_EXPECT_NEAR(received.wheel_torque[wheel], sent.wheel_torque[wheel], 30.0F * kFloat16Resolution);
  }
}

ZTEST(cart_messages, test_drive_status_round_trip) {
  unimoc_cart_DriveStatus_0_1 sent{};
  sent.wheel_speed = 52.0F;
  sent.estimated_torque = -18.5F;
  sent.drive_torque_limit = 40.0F;
  sent.brake_torque_limit = 22.0F;
  sent.dc_link_voltage = 51.2F;
  sent.dc_link_current = -9.5F;
  sent.power_stage_temperature = 318.15F;
  sent.motor_temperature = NAN;
  sent.wheel = unimoc_cart_WheelCommand_0_1_WHEEL_REAR_RIGHT;
  sent.power_stage = unimoc_cart_DriveStatus_0_1_POWER_STAGE_ENABLED;
  sent.engaged = true;
  sent.regen_derated = true;
  sent.overvoltage_tripped = true;

  std::array<uint8_t, unimoc_cart_DriveStatus_0_1_SERIALIZATION_BUFFER_SIZE_BYTES_> buffer{};
  size_t size = buffer.size();
  zassert_true(unimoc_cart_DriveStatus_0_1_serialize_(&sent, buffer.data(), &size) >= 0);
  zexpect_equal(size, 18U);

  unimoc_cart_DriveStatus_0_1 received{};
  zassert_true(unimoc_cart_DriveStatus_0_1_deserialize_(&received, buffer.data(), &size) >= 0);
  UNIMOC_EXPECT_NEAR(received.wheel_speed, sent.wheel_speed, 52.0F * kFloat16Resolution);
  UNIMOC_EXPECT_NEAR(received.estimated_torque, sent.estimated_torque, 18.5F * kFloat16Resolution);
  UNIMOC_EXPECT_NEAR(received.drive_torque_limit, sent.drive_torque_limit, 40.0F * kFloat16Resolution);
  UNIMOC_EXPECT_NEAR(received.brake_torque_limit, sent.brake_torque_limit, 22.0F * kFloat16Resolution);
  UNIMOC_EXPECT_NEAR(received.dc_link_voltage, sent.dc_link_voltage, 51.2F * kFloat16Resolution);
  UNIMOC_EXPECT_NEAR(received.dc_link_current, sent.dc_link_current, 9.5F * kFloat16Resolution);
  UNIMOC_EXPECT_NEAR(received.power_stage_temperature,
                     sent.power_stage_temperature,
                     318.15F * kFloat16Resolution);
  zexpect_true(std::isnan(received.motor_temperature), "an unmeasured value stays NaN");
  zexpect_equal(received.wheel, unimoc_cart_WheelCommand_0_1_WHEEL_REAR_RIGHT);
  zexpect_equal(received.power_stage, unimoc_cart_DriveStatus_0_1_POWER_STAGE_ENABLED);
  zexpect_true(received.engaged);
  zexpect_false(received.limp_home);
  zexpect_true(received.regen_derated);
  zexpect_false(received.overcurrent_tripped);
  zexpect_true(received.overvoltage_tripped);
}

ZTEST(cart_messages, test_pedal_state_round_trip) {
  unimoc_cart_PedalState_0_1 sent{};
  sent.drive_pedal[0] = 0.25F;
  sent.drive_pedal[1] = 0.26F;
  sent.brake_pedal[0] = 1.0F;
  sent.brake_pedal[1] = NAN;
  sent.drive_pedal_plausible = true;
  sent.brake_pedal_plausible = false;

  std::array<uint8_t, unimoc_cart_PedalState_0_1_SERIALIZATION_BUFFER_SIZE_BYTES_> buffer{};
  size_t size = buffer.size();
  zassert_true(unimoc_cart_PedalState_0_1_serialize_(&sent, buffer.data(), &size) >= 0);
  zexpect_equal(size, 9U);

  unimoc_cart_PedalState_0_1 received{};
  zassert_true(unimoc_cart_PedalState_0_1_deserialize_(&received, buffer.data(), &size) >= 0);
  UNIMOC_EXPECT_NEAR(received.drive_pedal[0], sent.drive_pedal[0], kFloat16Resolution);
  UNIMOC_EXPECT_NEAR(received.drive_pedal[1], sent.drive_pedal[1], kFloat16Resolution);
  UNIMOC_EXPECT_FLOAT_EQ(received.brake_pedal[0], 1.0F);
  zexpect_true(std::isnan(received.brake_pedal[1]), "a failed channel stays NaN");
  zexpect_true(received.drive_pedal_plausible);
  zexpect_false(received.brake_pedal_plausible);
}

ZTEST(cart_messages, test_battery_status_round_trip) {
  unimoc_cart_BatteryStatus_0_1 sent{};
  sent.voltage = 53.6F;
  sent.current = -20.0F;
  sent.state_of_charge = 0.95F;
  sent.discharge_current_limit = 50.0F;
  sent.charge_current_limit = 5.0F;
  sent.cell_temperature = 298.15F;
  sent.chopper_temperature = 350.0F;
  sent.contactor = unimoc_cart_BatteryStatus_0_1_CONTACTOR_OPENING;
  sent.chopper_active = true;

  std::array<uint8_t, unimoc_cart_BatteryStatus_0_1_SERIALIZATION_BUFFER_SIZE_BYTES_> buffer{};
  size_t size = buffer.size();
  zassert_true(unimoc_cart_BatteryStatus_0_1_serialize_(&sent, buffer.data(), &size) >= 0);
  zexpect_equal(size, 15U);

  unimoc_cart_BatteryStatus_0_1 received{};
  zassert_true(unimoc_cart_BatteryStatus_0_1_deserialize_(&received, buffer.data(), &size) >= 0);
  UNIMOC_EXPECT_NEAR(received.voltage, sent.voltage, 53.6F * kFloat16Resolution);
  UNIMOC_EXPECT_NEAR(received.current, sent.current, 20.0F * kFloat16Resolution);
  UNIMOC_EXPECT_NEAR(received.state_of_charge, sent.state_of_charge, kFloat16Resolution);
  UNIMOC_EXPECT_NEAR(received.discharge_current_limit,
                     sent.discharge_current_limit,
                     50.0F * kFloat16Resolution);
  UNIMOC_EXPECT_NEAR(received.charge_current_limit, sent.charge_current_limit, 5.0F * kFloat16Resolution);
  UNIMOC_EXPECT_NEAR(received.cell_temperature, sent.cell_temperature, 298.15F * kFloat16Resolution);
  UNIMOC_EXPECT_NEAR(received.chopper_temperature, sent.chopper_temperature, 350.0F * kFloat16Resolution);
  zexpect_equal(received.contactor, unimoc_cart_BatteryStatus_0_1_CONTACTOR_OPENING);
  zexpect_true(received.chopper_active);
}

ZTEST_SUITE(cart_messages, nullptr, nullptr, nullptr, nullptr, nullptr);

}  // namespace unimoc::cyphal::test
```

## src/control_mode_test.cpp
```c
/*
 *       __  ___   ________  _______  ______
 *      / / / / | / /  _/  |/  / __ \/ ____/
 *     / / / /  |/ // // /|_/ / / / / /
 *    / /_/ / /|  // // /  / / / /___
 *    \____/_/ |_/___/_/  /_/\____/\____/
 *
 *    @file control_mode_test.cpp
 *    @brief ztest coverage for Cyphal control-mode selection.
 *
 *    SPDX-License-Identifier: GPL-3.0-or-later
 *
 *    This file is part of UNIMOC and is licensed under GPL-3.0-or-later.
 *    See the repository LICENSE file for details.
 */

#include "cyphal/control_mode.hpp"
#include <zephyr/ztest.h>
#include <cmath>
#include <limits>
#include "unimoc_test.hpp"

namespace unimoc::cyphal::test {

ZTEST(control_mode, test_selects_position_from_finite_angular_position) {
  const auto kMode =
      SelectControlModeFromUdralServoRotation(0.35F, 400.0F, std::numeric_limits<float>::quiet_NaN(), 50.0F);
  zassert_true(kMode.has_value());
  zexpect_equal(*kMode, ControlMode::kPosition);
}

ZTEST(control_mode, test_selects_speed_when_position_is_not_finite) {
  const auto kMode = SelectControlModeFromUdralServoRotation(std::numeric_limits<float>::quiet_NaN(),
                                                             -120.0F,
                                                             std::numeric_limits<float>::quiet_NaN(),
                                                             50.0F);
  zassert_true(kMode.has_value());
  zexpect_equal(*kMode, ControlMode::kSpeed);
}

ZTEST(control_mode, test_selects_torque_when_no_kinematic_field_is_finite) {
  const auto kMode = SelectControlModeFromUdralServoRotation(std::numeric_limits<float>::quiet_NaN(),
                                                             std::numeric_limits<float>::quiet_NaN(),
                                                             std::numeric_limits<float>::quiet_NaN(),
                                                             30.0F);
  zassert_true(kMode.has_value());
  zexpect_equal(*kMode, ControlMode::kTorque);
}

ZTEST(control_mode, test_ignores_unsupported_acceleration_only_setpoint) {
  const auto kMode = SelectControlModeFromUdralServoRotation(std::numeric_limits<float>::quiet_NaN(),
                                                             std::numeric_limits<float>::quiet_NaN(),
                                                             25.0F,
                                                             std::numeric_limits<float>::quiet_NaN());
  zexpect_false(kMode.has_value());
}

ZTEST(control_mode, test_ignores_empty_setpoint) {
  const auto kMode = SelectControlModeFromUdralServoRotation(std::numeric_limits<float>::quiet_NaN(),
                                                             std::numeric_limits<float>::quiet_NaN(),
                                                             std::numeric_limits<float>::quiet_NaN(),
                                                             std::numeric_limits<float>::quiet_NaN());
  zexpect_false(kMode.has_value());
}

}  // namespace unimoc::cyphal::test

ZTEST_SUITE(control_mode, nullptr, nullptr, nullptr, nullptr, nullptr);
```

## src/cyphal_interface_test.cpp
```c
/*
 *       __  ___   ________  _______  ______
 *      / / / / | / /  _/  |/  / __ \/ ____/
 *     / / / /  |/ // // /|_/ / / / / /
 *    / /_/ / /|  // // /  / / / /___
 *    \____/_/ |_/___/_/  /_/\____/\____/
 *
 *    @file cyphal_interface_test.cpp
 *    @brief ztest coverage for Cyphal identifiers and command ranges.
 *
 *    SPDX-License-Identifier: GPL-3.0-or-later
 *
 *    This file is part of UNIMOC and is licensed under GPL-3.0-or-later.
 *    See the repository LICENSE file for details.
 */

/**
 * @file test_cyphal_interface.hpp
 * @brief Test fixture and cases for Cyphal interface identifiers.
 */
#include "cyphal/cyphal_interface.hpp"
#include <unimoc/drive/CommissioningStatus_0_1.h>
#include <zephyr/ztest.h>
#include <array>
#include "unimoc_test.hpp"

namespace unimoc::cyphal::test {

// --- Standard command codes match Cyphal specification §5.3.4 ---

ZTEST(cyphal_interface, test_standard_command_restart) { zexpect_equal(cmd::kCommandRestart, 65535U); }

ZTEST(cyphal_interface, test_standard_command_power_off) { zexpect_equal(cmd::kCommandPowerOff, 65534U); }

ZTEST(cyphal_interface, test_standard_command_begin_software_update) {
  zexpect_equal(cmd::kCommandBeginSoftwareUpdate, 65533U);
}

ZTEST(cyphal_interface, test_standard_command_factory_reset) {
  zexpect_equal(cmd::kCommandFactoryReset, 65532U);
}

ZTEST(cyphal_interface, test_standard_command_emergency_stop) {
  zexpect_equal(cmd::kCommandEmergencyStop, 65531U);
}

ZTEST(cyphal_interface, test_standard_command_store_persistent_states) {
  zexpect_equal(cmd::kCommandStorePersistentStates, 65530U);
}

// --- Standard command codes are in the reserved range (≥ 0xFF00) ---

ZTEST(cyphal_interface, test_standard_commands_in_reserved_range) {
  zexpect_true((cmd::kCommandRestart) >= (0xFF00U));
  zexpect_true((cmd::kCommandPowerOff) >= (0xFF00U));
  zexpect_true((cmd::kCommandBeginSoftwareUpdate) >= (0xFF00U));
  zexpect_true((cmd::kCommandFactoryReset) >= (0xFF00U));
  zexpect_true((cmd::kCommandEmergencyStop) >= (0xFF00U));
  zexpect_true((cmd::kCommandStorePersistentStates) >= (0xFF00U));
}

// --- Vendor-specific diagnostics commands ---

ZTEST(cyphal_interface, test_diagnostics_commands_in_their_range) {
  zexpect_equal(cmd::kCmdResetTiming, 0x0300U);  // above the retired codes and the commissioning
}

// --- Commissioning (startup aid, motor identification) ---

ZTEST(cyphal_interface, test_commissioning_port_after_the_drive_status) {
  zexpect_equal(kPubCommissioning, 215U);
  zexpect_true(kPubCommissioning > kPubDriveStatus);
}

ZTEST(cyphal_interface, test_commissioning_commands_in_their_range) {
  const std::array<uint16_t, 6> kCodes = {
      unimoc_drive_CommissioningStatus_0_1_COMMAND_START_STARTUP_AID,
      unimoc_drive_CommissioningStatus_0_1_COMMAND_START_IDENTIFICATION,
      unimoc_drive_CommissioningStatus_0_1_COMMAND_CONTINUE,
      unimoc_drive_CommissioningStatus_0_1_COMMAND_SET_READING,
      unimoc_drive_CommissioningStatus_0_1_COMMAND_ABORT,
      unimoc_drive_CommissioningStatus_0_1_COMMAND_APPLY_IDENTIFICATION,
  };
  for (std::size_t i = 0; i < kCodes.size(); ++i) {
    zexpect_true(kCodes[i] >= 0x0200U && kCodes[i] <= 0x02FFU);
    for (std::size_t j = i + 1; j < kCodes.size(); ++j) {
      zexpect_not_equal(kCodes[i], kCodes[j]);
    }
  }
}

// --- Response status codes ---

ZTEST(cyphal_interface, test_status_success) { zexpect_equal(cmd::kStatusSuccess, 0U); }

// Values of uavcan.node.ExecuteCommand.1.3 Response.STATUS_*.
ZTEST(cyphal_interface, test_status_codes_match_the_specification) {
  zexpect_equal(cmd::kStatusFailure, 1U);
  zexpect_equal(cmd::kStatusNotAuthorized, 2U);
  zexpect_equal(cmd::kStatusBadCommand, 3U);
  zexpect_equal(cmd::kStatusBadParameter, 4U);
  zexpect_equal(cmd::kStatusBadState, 5U);
  zexpect_equal(cmd::kStatusInternalError, 6U);
}

ZTEST(cyphal_interface, test_status_codes_unique) {
  const std::array<uint8_t, 6> kStatuses = {
      cmd::kStatusSuccess,
      cmd::kStatusFailure,
      cmd::kStatusNotAuthorized,
      cmd::kStatusBadState,
      cmd::kStatusBadParameter,
      cmd::kStatusBadCommand,
  };
  constexpr std::size_t kCount = kStatuses.size();
  for (std::size_t i = 0; i < kCount; ++i) {
    for (std::size_t j = i + 1; j < kCount; ++j) {
      zexpect_not_equal(kStatuses[i],
                        kStatuses[j],
                        "Duplicate status code at indices %d and %d",
                        static_cast<int>(i),
                        static_cast<int>(j));
    }
  }
}

}  // namespace unimoc::cyphal::test

ZTEST_SUITE(cyphal_interface, nullptr, nullptr, nullptr, nullptr, nullptr);
```

## src/cyphal_transport_test.cpp
```c
/*
 *       __  ___   ________  _______  ______
 *      / / / / | / /  _/  |/  / __ \/ ____/
 *     / / / /  |/ // // /|_/ / / / / /
 *    / /_/ / /|  // // /  / / / /___
 *    \____/_/ |_/___/_/  /_/\____/\____/
 *
 *    @file cyphal_transport_test.cpp
 *    @brief ztest coverage of the injected Cyphal transport boundary.
 *
 *    SPDX-License-Identifier: GPL-3.0-or-later
 *
 *    This file is part of UNIMOC and is licensed under GPL-3.0-or-later.
 *    See the repository LICENSE file for details.
 */
#include <zephyr/ztest.h>
#include <array>
#include <cstddef>
#include <cstring>
#include <span>
#include "cyphal/node.hpp"
#include "unimoc_test.hpp"

namespace unimoc::cyphal::test {
namespace {

class FakeTransport final : public Transport {
 public:
  bool Send(const Transfer& transfer) noexcept override {
    sent_transfer = transfer;
    return send_result;
  }

  ReceiveResult Receive(std::span<std::byte> payload_buffer, Transfer& transfer) noexcept override {
    if (receive_result != ReceiveResult::kReceived) {
      return receive_result;
    }
    if (payload.size() > payload_buffer.size()) {
      return ReceiveResult::kError;
    }
    std::memcpy(payload_buffer.data(), payload.data(), payload.size());
    transfer = received_transfer;
    transfer.payload = payload_buffer.first(payload.size());
    return ReceiveResult::kReceived;
  }

  bool Subscribe(TransferKind /*kind*/, uint16_t /*port_id*/, std::size_t /*extent*/) noexcept override {
    return true;
  }
  void SetLocalNodeId(uint8_t node_id) noexcept override { local_node_id = node_id; }
  [[nodiscard]] uint8_t LocalNodeId() const noexcept override { return local_node_id; }
  void Process(uint64_t /*now_us*/) noexcept override {}

  bool send_result{true};
  uint8_t local_node_id{kNodeIdUnset};
  ReceiveResult receive_result{ReceiveResult::kNoTransfer};
  Transfer sent_transfer{};
  Transfer received_transfer{};
  std::span<const std::byte> payload;
};

ZTEST(cyphal_node, test_sends_through_injected_transport) {
  FakeTransport fake;
  CyphalNode node{fake};
  const std::array<std::byte, 2U> kPayload{std::byte{0x12}, std::byte{0x34}};
  const Transfer kTransfer{
      .port_id = 42U,
      .source_node_id = 10U,
      .destination_node_id = 20U,
      .transfer_id = 3U,
      .kind = TransferKind::kServiceRequest,
      .payload = kPayload,
  };

  zassert_true(node.Send(kTransfer));
  zexpect_equal(fake.sent_transfer.port_id, 42U);
  zexpect_equal(fake.sent_transfer.source_node_id, 10U);
  zexpect_equal(fake.sent_transfer.destination_node_id, 20U);
  zexpect_equal(fake.sent_transfer.kind, TransferKind::kServiceRequest);
  zassert_equal(fake.sent_transfer.payload.size(), kPayload.size());
  zexpect_equal(std::memcmp(fake.sent_transfer.payload.data(), kPayload.data(), kPayload.size()), 0);
}

ZTEST(cyphal_node, test_polls_into_caller_owned_buffer) {
  FakeTransport fake;
  CyphalNode node{fake};
  const std::array<std::byte, 3U> kInput{std::byte{0x01}, std::byte{0x02}, std::byte{0x03}};
  fake.receive_result = ReceiveResult::kReceived;
  fake.received_transfer = Transfer{
      .port_id = 100U,
      .source_node_id = 7U,
      .destination_node_id = 255U,
      .transfer_id = 9U,
      .kind = TransferKind::kMessage,
      .payload = {},
  };
  fake.payload = kInput;
  std::array<std::byte, 8U> k_buffer{};
  Transfer received{};

  zexpect_equal(node.Poll(k_buffer, received), ReceiveResult::kReceived);
  zexpect_equal(received.port_id, 100U);
  zexpect_equal(received.source_node_id, 7U);
  zassert_equal(received.payload.size(), kInput.size());
  zexpect_equal(std::memcmp(received.payload.data(), kInput.data(), kInput.size()), 0);
  zexpect_equal(std::memcmp(k_buffer.data(), kInput.data(), kInput.size()), 0);
}

}  // namespace
}  // namespace unimoc::cyphal::test

ZTEST_SUITE(cyphal_node, nullptr, nullptr, nullptr, nullptr, nullptr);
```

## src/firmware_update_test.cpp
```c
/*
 *       __  ___   ________  _______  ______
 *      / / / / | / /  _/  |/  / __ \/ ____/
 *     / / / /  |/ // // /|_/ / / / / /
 *    / /_/ / /|  // //  /  / /_/ / /___
 *    \____/_/ |_/___/_/  /_/\____/\____/
 *
 *    @file firmware_update_test.cpp
 *    @brief Tests of the firmware image header, the download into the bank and uavcan.file.Read.
 *
 *    SPDX-License-Identifier: GPL-3.0-or-later
 *
 *    This file is part of UNIMOC and is licensed under GPL-3.0-or-later.
 *    See the repository LICENSE file for details.
 */
#include "cyphal/firmware_update.hpp"
#include <zephyr/ztest.h>
#include <algorithm>
#include <array>
#include <cstddef>
#include <cstdint>
#include <new>
#include <span>
#include <string_view>
#include "can_test_bus.hpp"
#include "cyphal/canard_transport.hpp"
#include "cyphal/cyphal_interface.hpp"
#include "cyphal/file_service.hpp"
#include "cyphal/firmware_image.hpp"
#include "cyphal/node.hpp"

namespace unimoc::cyphal::test {
namespace {

using unimoc::test::CanTestBus;
using unimoc::test::CanTestMedia;

constexpr std::string_view kBoard = "native_sim";
constexpr std::size_t kPayloadSize = 1000U;  // with the header: four full chunks and a short one
constexpr std::size_t kImageSize = FirmwareImageHeader::kSize + kPayloadSize;

// ----- A RAM bank ---------------------------------------------------------------

constexpr uint32_t kBankSize = 16384U;
std::array<std::byte, kBankSize> g_bank{};
bool g_bank_fails{false};

bool g_activated{false};
ImageStatus g_activate_result{ImageStatus::kOk};

bool Begin() noexcept {
  g_bank.fill(std::byte{0xFF});
  g_activated = false;
  return true;
}

bool Finish() noexcept { return true; }

ImageStatus Activate() noexcept {
  g_activated = (g_activate_result == ImageStatus::kOk);
  return g_activate_result;
}

bool Write(const uint32_t offset, const std::span<const std::byte> data) noexcept {
  if (g_bank_fails || offset + data.size() > g_bank.size()) {
    return false;
  }
  std::copy(data.begin(), data.end(), g_bank.begin() + offset);
  return true;
}

bool ReadBank(const uint32_t offset, const std::span<std::byte> data) noexcept {
  if (offset + data.size() > g_bank.size()) {
    return false;
  }
  std::copy_n(g_bank.begin() + offset, data.size(), data.begin());
  return true;
}

constexpr FirmwareBank kBank{Begin, Write, Finish, ReadBank, Activate, kBankSize};
constexpr FirmwareBank kSmallBank{Begin, Write, Finish, ReadBank, Activate, 512U};
constexpr FirmwareBank kNoBank{};

// ----- Images -------------------------------------------------------------------

void PutLe32(std::span<std::byte> bytes, const std::size_t offset, const uint32_t value) {
  for (std::size_t i = 0U; i < 4U; ++i) {
    bytes[offset + i] = static_cast<std::byte>((value >> (8U * i)) & 0xFFU);
  }
}

/// An image as scripts/make_firmware_image.py writes it.
template <std::size_t kPayloadBytes = kPayloadSize>
std::array<std::byte, FirmwareImageHeader::kSize + kPayloadBytes> MakeImage(
    const std::string_view board = kBoard) {
  std::array<std::byte, FirmwareImageHeader::kSize + kPayloadBytes> image{};
  const std::span<std::byte> kPayload{image.data() + FirmwareImageHeader::kSize, kPayloadBytes};
  for (std::size_t i = 0U; i < kPayload.size(); ++i) {
    kPayload[i] = static_cast<std::byte>((i * 7U) & 0xFFU);
  }
  std::copy(FirmwareImageHeader::kMagic.begin(),
            FirmwareImageHeader::kMagic.end(),
            reinterpret_cast<uint8_t*>(image.data()));
  image[4] = std::byte{1U};  // header version
  image[6] = std::byte{2U};  // software 2.5
  image[7] = std::byte{5U};
  PutLe32(image, 8U, 0x89ABCDEFU);
  PutLe32(image, 12U, 0x01234567U);
  PutLe32(image, 16U, kPayloadBytes);
  PutLe32(image, 20U, Crc32Final(Crc32Update(Crc32Init(), kPayload)));
  std::copy(board.begin(), board.end(), reinterpret_cast<char*>(image.data() + 24U));
  return image;
}

/// Answers every request of @p update from @p image until it ends.
void Serve(FirmwareUpdate& update, const std::span<const std::byte> image, uint64_t& now_us) {
  for (unsigned i = 0U; i < 100U && update.GetState() == FirmwareUpdate::State::kDownloading; ++i) {
    now_us += 1000U;
    const auto kRequest = update.Poll(now_us);
    if (!kRequest.has_value()) {
      continue;
    }
    const std::size_t kOffset = std::min<std::size_t>(kRequest->offset, image.size());
    const std::size_t kLength = std::min(FirmwareUpdate::kChunk, image.size() - kOffset);
    update.OnResponse(0U, image.subspan(kOffset, kLength));
  }
}

ZTEST(firmware_update, test_crc32_is_ieee_802_3) {
  constexpr std::string_view kCheck = "123456789";
  const std::span<const std::byte> kBytes{reinterpret_cast<const std::byte*>(kCheck.data()), kCheck.size()};
  zexpect_equal(Crc32Final(Crc32Update(Crc32Init(), kBytes)), 0xCBF43926U);
  // Incremental: two parts give the same.
  const uint32_t kParts = Crc32Update(Crc32Update(Crc32Init(), kBytes.first(4U)), kBytes.subspan(4U));
  zexpect_equal(Crc32Final(kParts), 0xCBF43926U);
}

ZTEST(firmware_update, test_header_is_parsed_and_checked) {
  auto image = MakeImage();
  FirmwareImageHeader header{};
  zassert_equal(ParseImageHeader(image, header), ImageStatus::kOk);
  zexpect_equal(header.software_major, 2U);
  zexpect_equal(header.software_minor, 5U);
  zexpect_equal(header.vcs_revision, 0x0123456789ABCDEFULL);
  zexpect_equal(header.payload_size, kPayloadSize);
  zexpect_true(header.Board() == kBoard);

  zexpect_equal(ParseImageHeader(std::span<const std::byte>{image}.first(39U), header),
                ImageStatus::kTooShort);
  image[4] = std::byte{2U};
  zexpect_equal(ParseImageHeader(image, header), ImageStatus::kBadVersion);
  image[0] = std::byte{'X'};
  zexpect_equal(ParseImageHeader(image, header), ImageStatus::kBadMagic);
}

ZTEST(firmware_update, test_a_good_image_is_ready_in_the_bank) {
  const auto kImage = MakeImage();
  FirmwareUpdate update{kBank, kBoard};
  zexpect_equal(update.GetState(), FirmwareUpdate::State::kIdle);
  zassert_true(update.Begin(7U, "unimoc.bin"));
  zexpect_false(update.Begin(7U, "again.bin"));  // one download at a time

  uint64_t now = 0U;
  const auto kFirst = update.Poll(now);
  zassert_true(kFirst.has_value());
  zexpect_equal(kFirst->server, 7U);
  zexpect_equal(kFirst->offset, 0U);
  zexpect_true(kFirst->path == "unimoc.bin");
  zexpect_false(update.Poll(now + 1000U).has_value());  // waits for the answer
  update.OnResponse(0U, std::span<const std::byte>{kImage}.first(FirmwareUpdate::kChunk));

  Serve(update, kImage, now);
  zassert_equal(update.GetState(), FirmwareUpdate::State::kReady);
  zexpect_equal(update.Result(), ImageStatus::kOk);
  zexpect_equal(update.Received(), kImageSize);
  zexpect_equal(update.Header().software_minor, 5U);
  // The bank holds the payload behind the UNIMOC header, and the bootloader was told to take it over.
  zexpect_true(std::equal(kImage.begin() + FirmwareImageHeader::kSize, kImage.end(), g_bank.begin()));
  zexpect_true(g_activated);
}

ZTEST(firmware_update, test_a_file_of_whole_chunks_ends_with_an_empty_read) {
  std::array<std::byte, 512U> image{};
  const auto kGood = MakeImage();
  std::copy_n(kGood.begin(), FirmwareImageHeader::kSize, image.begin());
  const std::span<std::byte> kPayload{image.data() + FirmwareImageHeader::kSize,
                                      image.size() - FirmwareImageHeader::kSize};
  PutLe32(image, 16U, static_cast<uint32_t>(kPayload.size()));
  PutLe32(image, 20U, Crc32Final(Crc32Update(Crc32Init(), kPayload)));
  FirmwareUpdate update{kBank, kBoard};
  zassert_true(update.Begin(7U, "a"));
  uint64_t now = 0U;
  Serve(update, image, now);
  zexpect_equal(update.GetState(), FirmwareUpdate::State::kReady);
  zexpect_equal(update.Received(), image.size());
}

ZTEST(firmware_update, test_a_bad_image_fails_with_its_reason) {
  uint64_t now = 0U;
  {
    auto image = MakeImage();
    image[FirmwareImageHeader::kSize + 3U] ^= std::byte{0x01};
    FirmwareUpdate update{kBank, kBoard};
    zassert_true(update.Begin(7U, "a"));
    Serve(update, image, now);
    zexpect_equal(update.GetState(), FirmwareUpdate::State::kFailed);
    zexpect_equal(update.Result(), ImageStatus::kBadChecksum);
  }
  {
    const auto kImage = MakeImage("unimoc_jacobi");
    FirmwareUpdate update{kBank, kBoard};
    zassert_true(update.Begin(7U, "a"));
    Serve(update, kImage, now);
    zexpect_equal(update.Result(), ImageStatus::kWrongBoard);
  }
  {
    const auto kImage = MakeImage();
    FirmwareUpdate update{kBank, kBoard};
    zassert_true(update.Begin(7U, "a"));
    Serve(update, std::span<const std::byte>{kImage}.first(kImageSize - 1U), now);  // cut short
    zexpect_equal(update.Result(), ImageStatus::kWrongSize);
  }
  {
    const auto kImage = MakeImage();
    FirmwareUpdate update{kSmallBank, kBoard};
    zassert_true(update.Begin(7U, "a"));
    Serve(update, kImage, now);
    zexpect_equal(update.Result(), ImageStatus::kTooLarge);
  }
  {
    FirmwareUpdate update{kBank, kBoard};
    zassert_true(update.Begin(7U, "a"));
    (void)update.Poll(now);
    update.OnResponse(2U, {});  // uavcan.file.Error NOT_FOUND
    zexpect_equal(update.GetState(), FirmwareUpdate::State::kFailed);
    zexpect_equal(update.FileError(), 2U);
  }
  {
    const auto kImage = MakeImage();
    g_bank_fails = true;
    FirmwareUpdate update{kBank, kBoard};
    zassert_true(update.Begin(7U, "a"));
    Serve(update, kImage, now);
    g_bank_fails = false;
    zexpect_equal(update.FileError(), FirmwareUpdate::kErrorBank);
  }
}

ZTEST(firmware_update, test_the_bootloader_can_refuse_the_image) {
  const auto kImage = MakeImage();
  uint64_t now = 0U;
  for (const ImageStatus kRefusal : {ImageStatus::kNotNewer, ImageStatus::kNoBootImage}) {
    g_activate_result = kRefusal;
    FirmwareUpdate update{kBank, kBoard};
    zassert_true(update.Begin(7U, "a"));
    Serve(update, kImage, now);
    zexpect_equal(update.GetState(), FirmwareUpdate::State::kFailed);
    zexpect_equal(update.Result(), kRefusal);
    zexpect_false(g_activated);
  }
  g_activate_result = ImageStatus::kOk;
}

ZTEST(firmware_update, test_a_wrong_image_is_refused_before_the_bank_is_written) {
  const auto kImage = MakeImage("unimoc_jacobi");
  g_bank.fill(std::byte{0x5A});
  FirmwareUpdate update{kBank, kBoard};
  zassert_true(update.Begin(7U, "a"));
  g_bank.fill(std::byte{0x5A});
  uint64_t now = 0U;
  Serve(update, kImage, now);
  zexpect_equal(update.Result(), ImageStatus::kWrongBoard);
  zexpect_equal(update.Received(), 0U);
  zexpect_true(std::all_of(g_bank.begin(), g_bank.end(), [](const std::byte kByte) {
    return kByte == std::byte{0x5A};
  }));
}

ZTEST(firmware_update, test_a_silent_server_is_retried_then_given_up) {
  FirmwareUpdate update{kBank, kBoard};
  zassert_true(update.Begin(7U, "a"));
  uint64_t now = 0U;
  zassert_true(update.Poll(now).has_value());
  unsigned repeats = 0U;
  for (unsigned i = 0U; i < 10U; ++i) {
    now += FirmwareUpdate::kTimeoutUs;
    const auto kRequest = update.Poll(now);
    if (kRequest.has_value()) {
      ++repeats;
      zexpect_equal(kRequest->offset, 0U);  // the same request again
    }
  }
  zexpect_equal(repeats, FirmwareUpdate::kRetries);
  zexpect_equal(update.GetState(), FirmwareUpdate::State::kFailed);
  zexpect_equal(update.FileError(), FirmwareUpdate::kErrorTimeout);
}

ZTEST(firmware_update, test_begin_is_refused_without_a_bank_or_path) {
  FirmwareUpdate none{kNoBank, kBoard};
  zexpect_false(none.Begin(7U, "a"));
  FirmwareUpdate update{kBank, kBoard};
  zexpect_false(update.Begin(7U, ""));
  zexpect_false(update.Begin(7U, std::string_view{"x", 0U}));
  std::array<char, FirmwareUpdate::kMaxPath + 1U> long_path{};
  long_path.fill('a');
  zexpect_false(update.Begin(7U, std::string_view{long_path.data(), long_path.size()}));
}

// ----- Two nodes on one bus: uavcan.file.Read end to end ------------------------------

constexpr uint8_t kDriveId = 20U;
constexpr uint8_t kServerId = 5U;

/// Serves one file, the image.
class ImageSource final : public FileSource {
 public:
  explicit ImageSource(std::span<const std::byte> image) : image_{image} {}
  [[nodiscard]] FileReadResult Read(const std::string_view path,
                                    const uint64_t offset,
                                    const std::span<std::byte> data) noexcept override {
    ++reads_;
    if (path != "fw/unimoc.bin") {
      return {file_error::kNotFound, 0U};
    }
    const std::size_t kOffset = std::min<std::size_t>(offset, image_.size());
    const std::size_t kLength = std::min(data.size(), image_.size() - kOffset);
    std::copy_n(image_.begin() + static_cast<std::ptrdiff_t>(kOffset), kLength, data.begin());
    return {file_error::kOk, kLength};
  }
  [[nodiscard]] unsigned Reads() const { return reads_; }

 private:
  std::span<const std::byte> image_;
  unsigned reads_{0U};
};

struct Pair {
  explicit Pair(std::span<const std::byte> image)
      : drive_media{bus, kCanFdMtu},
        server_media{bus, kCanFdMtu},
        drive_interfaces{&drive_media},
        server_interfaces{&server_media},
        drive_transport{drive_arena.bytes, drive_interfaces},
        server_transport{server_arena.bytes, server_interfaces},
        drive{drive_transport},
        server{server_transport},
        source{image},
        file_server{source},
        update{kBank, kBoard} {}

  void Run(const unsigned rounds) {
    for (unsigned i = 0U; i < rounds; ++i) {
      now += 1000U;
      drive.Spin(now);  // first: the transport clock dates the request of update.Spin()
      update.Spin(now);
      server.Spin(now);
    }
  }

  CanardArena<32768> drive_arena;
  CanardArena<32768> server_arena;
  CanTestBus bus;
  CanTestMedia drive_media;
  CanTestMedia server_media;
  std::array<CanMedia*, 1> drive_interfaces;
  std::array<CanMedia*, 1> server_interfaces;
  CanardTransport drive_transport;
  CanardTransport server_transport;
  CyphalNode drive;
  CyphalNode server;
  ImageSource source;
  FileServer file_server;
  FirmwareUpdateService update;
  uint64_t now{1'000'000U};
};

Pair& MakePair(std::span<const std::byte> image) {
  alignas(Pair) static std::array<std::byte, sizeof(Pair)> storage;
  static Pair* pair = nullptr;
  if (pair != nullptr) {
    pair->~Pair();
  }
  // NOLINTNEXTLINE(cppcoreguidelines-owning-memory): placement new into static storage.
  pair = new (storage.data()) Pair{image};
  return *pair;
}

std::span<const uint8_t> Path(const std::string_view path) {
  return std::span<const uint8_t>{reinterpret_cast<const uint8_t*>(path.data()), path.size()};
}

uint32_t ReadNatural(const RegisterProvider& provider, const std::size_t index) {
  RegisterValue value{};
  (void)provider.Read(index, value);
  return static_cast<uint32_t>(GetInteger(value).value_or(-1));
}

ZTEST(firmware_update, test_the_service_downloads_over_file_read) {
  static const auto kImage = MakeImage();
  Pair& pair = MakePair(kImage);
  zassert_true(pair.update.Start(pair.drive));
  zassert_true(pair.server.AddServer(port::kFileRead, FileServer::kRequestExtent, pair.file_server));
  zassert_true(pair.drive.Start(kDriveId, pair.now));
  zassert_true(pair.server.Start(kServerId, pair.now));
  zexpect_equal(pair.update.Count(), 5U);
  zexpect_true(pair.update.Name(0U) == "unimoc.update.state");

  zexpect_equal(pair.update.Begin(kNodeIdUnset, Path("fw/unimoc.bin")).status, cmd::kStatusBadParameter);
  zexpect_equal(pair.update.Begin(kServerId, Path("")).status, cmd::kStatusBadParameter);
  zassert_equal(pair.update.Begin(kServerId, Path("fw/unimoc.bin")).status, cmd::kStatusSuccess);
  zexpect_true(pair.update.Downloading());
  zexpect_equal(pair.update.Begin(kServerId, Path("fw/unimoc.bin")).status, cmd::kStatusBadState);

  pair.Run(100U);
  zassert_equal(pair.update.Update().GetState(), FirmwareUpdate::State::kReady);
  zexpect_equal(pair.source.Reads(), 5U);  // 1040 bytes: four full reads of 256 bytes and a short one
  zexpect_equal(ReadNatural(pair.update, 0U), 2U);  // ready
  zexpect_equal(ReadNatural(pair.update, 1U), 0U);  // ok
  zexpect_equal(ReadNatural(pair.update, 3U), kImageSize);
  zexpect_true(std::equal(kImage.begin() + FirmwareImageHeader::kSize, kImage.end(), g_bank.begin()));
}

ZTEST(firmware_update, test_a_long_download_wraps_the_five_bit_transfer_id) {
  // 12 KB: 49 requests, so the transfer-ID of the request wraps at 32; the response carries it modulo 32.
  static const auto kImage = MakeImage<12000U>();
  Pair& pair = MakePair(kImage);
  zassert_true(pair.update.Start(pair.drive));
  zassert_true(pair.server.AddServer(port::kFileRead, FileServer::kRequestExtent, pair.file_server));
  zassert_true(pair.drive.Start(kDriveId, pair.now));
  zassert_true(pair.server.Start(kServerId, pair.now));
  zassert_equal(pair.update.Begin(kServerId, Path("fw/unimoc.bin")).status, cmd::kStatusSuccess);
  pair.Run(400U);
  zassert_equal(pair.update.Update().GetState(), FirmwareUpdate::State::kReady);
  zexpect_equal(pair.source.Reads(), 48U);  // 12040 bytes: 47 full reads and a short one
  zexpect_true(std::equal(kImage.begin() + FirmwareImageHeader::kSize, kImage.end(), g_bank.begin()));
}

ZTEST(firmware_update, test_an_unknown_file_fails_with_not_found) {
  static const auto kImage = MakeImage();
  Pair& pair = MakePair(kImage);
  zassert_true(pair.update.Start(pair.drive));
  zassert_true(pair.server.AddServer(port::kFileRead, FileServer::kRequestExtent, pair.file_server));
  zassert_true(pair.drive.Start(kDriveId, pair.now));
  zassert_true(pair.server.Start(kServerId, pair.now));
  zassert_equal(pair.update.Begin(kServerId, Path("fw/other.bin")).status, cmd::kStatusSuccess);
  pair.Run(20U);
  zexpect_equal(pair.update.Update().GetState(), FirmwareUpdate::State::kFailed);
  zexpect_equal(ReadNatural(pair.update, 2U), file_error::kNotFound);
}

ZTEST(firmware_update, test_clients_are_checked) {
  static const auto kImage = MakeImage();
  Pair& pair = MakePair(kImage);
  zexpect_false(pair.drive.Request(port::kFileRead, kServerId, 0U, {}));  // not added
  zassert_true(pair.update.Start(pair.drive));
  zexpect_false(pair.drive.AddClient(port::kFileRead, 8U, pair.update));  // taken
  zexpect_false(pair.drive.AddClient(512U, 8U, pair.update));             // no service-ID
  zexpect_false(pair.drive.Request(port::kFileRead, kServerId, 0U, {}));  // no node-ID yet
  zassert_true(pair.drive.Start(kDriveId, pair.now));
  zexpect_false(pair.drive.Request(port::kFileRead, 200U, 0U, {}));  // no server
}

}  // namespace

ZTEST_SUITE(firmware_update, nullptr, nullptr, nullptr, nullptr, nullptr);

}  // namespace unimoc::cyphal::test
```

## src/node_identity_test.cpp
```c
/*
 *       __  ___   ________  _______  ______
 *      / / / / | / /  _/  |/  / __ \/ ____/
 *     / / / /  |/ // // /|_/ / / / / /
 *    / /_/ / /|  // // /  / / / /___
 *    \____/_/ |_/___/_/  /_/\____/\____/
 *
 *    @file node_identity_test.cpp
 *    @brief ztest coverage for the Cyphal node identity record.
 *
 *    SPDX-License-Identifier: GPL-3.0-or-later
 *
 *    This file is part of UNIMOC and is licensed under GPL-3.0-or-later.
 *    See the repository LICENSE file for details.
 */

#include "cyphal/node_identity.hpp"
#include <zephyr/ztest.h>
#include <cstring>
#include <string>
#include <string_view>
#include "unimoc_test.hpp"

namespace unimoc::cyphal::test {

// --- Default construction
ZTEST(node_identity, test_default_name) {
  NodeIdentity identity;
  zexpect_str_equal(identity.name.data(), "unimoc");
}

ZTEST(node_identity, test_default_versions) {
  NodeIdentity identity;
  zexpect_equal(identity.hw_version_major, 1U);
  zexpect_equal(identity.hw_version_minor, 0U);
  zexpect_equal(identity.sw_version_major, 1U);
  zexpect_equal(identity.sw_version_minor, 0U);
}

// --- set_name / get_name
ZTEST(node_identity, test_set_and_get_name) {
  NodeIdentity identity;
  identity.SetName("my.drive.node");
  zexpect_equal(identity.GetName(), std::string_view("my.drive.node"));
}

ZTEST(node_identity, test_set_name_truncates_at_max_len) {
  NodeIdentity identity;
  // Build a 60-char string — should be truncated to NODE_NAME_MAX_LEN (50)
  const std::string kLongName(60, 'x');
  identity.SetName(kLongName);
  zexpect_equal(identity.GetName().size(), static_cast<std::size_t>(kNodeNameMaxLen));
  zexpect_equal(identity.name[kNodeNameMaxLen], '\0');
}

ZTEST(node_identity, test_set_name_empty) {
  NodeIdentity identity;
  identity.SetName("");
  zexpect_equal(identity.GetName().size(), 0U);
  zexpect_equal(identity.name[0], '\0');
}

ZTEST(node_identity, test_set_name_exactly_max_len) {
  NodeIdentity identity;
  const std::string kExact(kNodeNameMaxLen, 'a');
  identity.SetName(kExact);
  zexpect_equal(identity.GetName().size(), static_cast<std::size_t>(kNodeNameMaxLen));
  zexpect_equal(identity.name[kNodeNameMaxLen], '\0');
}

// --- Equality
ZTEST(node_identity, test_equality_default) {
  NodeIdentity a;
  NodeIdentity b;
  zexpect_equal(a, b);
}

ZTEST(node_identity, test_inequality_name) {
  NodeIdentity a;
  NodeIdentity b;
  b.SetName("other");
  zexpect_not_equal(a, b);
}

ZTEST(node_identity, test_inequality_hw_version) {
  NodeIdentity a;
  NodeIdentity b;
  b.hw_version_major = 2U;
  zexpect_not_equal(a, b);
}

}  // namespace unimoc::cyphal::test

ZTEST_SUITE(node_identity, nullptr, nullptr, nullptr, nullptr, nullptr);
```
