## CMakeLists.txt
```
# SPDX-License-Identifier: GPL-3.0-or-later
#
# Overcurrent path on native_sim: the per-sample check of the hardware layer
# trips the power stage, the control cycle freezes the loop, a startup run
# acknowledges the trip.
cmake_minimum_required(VERSION 3.20.0)

find_package(Zephyr REQUIRED HINTS $ENV{ZEPHYR_BASE})
project(unimoc_sim_overcurrent)

# The UNIMOC module (CONFIG_UNIMOC) declares the library targets.
set(UNIMOC_ROOT ${ZEPHYR_UNIMOC_MODULE_DIR})

target_sources(app PRIVATE
  src/main.cpp
  ${UNIMOC_ROOT}/src/current_control/current_control_isr.cpp
  ${UNIMOC_ROOT}/src/current_control/slow_update.cpp
  ${UNIMOC_ROOT}/src/current_control/outer_loop.cpp
  ${UNIMOC_ROOT}/src/startup/hw_startup.cpp
  ${UNIMOC_ROOT}/hardware/zephyr_common/system_interface.cpp
  ${UNIMOC_ROOT}/hardware/zephyr_common/zephyr_settings_storage.cpp
  ${UNIMOC_ROOT}/hardware/zephyr_sim/hardware_interface.cpp)
target_include_directories(app PRIVATE
  ${UNIMOC_ROOT}/src/current_control
  ${UNIMOC_ROOT}/src/startup
  ${UNIMOC_ROOT}/hardware/zephyr_sim
  ${UNIMOC_ROOT}/hardware/zephyr_common
  ${UNIMOC_ROOT}/tests/common)
target_link_libraries(app PRIVATE unimoc_lib unimoc_sim)
```

## prj.conf
```kconfig
# SPDX-License-Identifier: GPL-3.0-or-later
CONFIG_ZTEST=y
CONFIG_CPP=y
CONFIG_UNIMOC=y
CONFIG_STD_CPP20=y
CONFIG_REQUIRES_FULL_LIBCPP=y
CONFIG_SYS_CLOCK_TICKS_PER_SEC=1000000
CONFIG_LOG=y
CONFIG_UNIMOC_LOG_LEVEL_DBG=y
```

## src/main.cpp
```c
/*
 *       __  ___   ________  _______  ______
 *      / / / / | / /  _/  |/  / __ \/ ____/
 *     / / / /  |/ // // /|_/ / / / / /
 *    / /_/ / /|  // // /  / / / /___
 *    \____/_/ |_/___/_/  /_/\____/\____/
 *
 *    @file main.cpp
 *    @brief Per-sample overcurrent trip, loop freeze and startup acknowledgement on native_sim.
 *
 *    SPDX-License-Identifier: GPL-3.0-or-later
 *
 *    This file is part of UNIMOC and is licensed under GPL-3.0-or-later.
 *    See the repository LICENSE file for details.
 */
#include <zephyr/ztest.h>
#include "current_control_isr.hpp"
#include "current_control_runtime.hpp"
#include "hardware_interface.hpp"
#include "hot_path_interface.hpp"
#include "hw_startup.hpp"
#include "power_stage_interface.hpp"
#include "settings_store.hpp"
#include "sim_control.hpp"
#include "sim_test_motor.hpp"
#include "slow_update.hpp"
#include "unimoc_test.hpp"

namespace {

using unimoc::current_control::CurrentControlIsr;
using unimoc::current_control::SlowUpdate;
using unimoc::hardware::kPowerStage;
using unimoc::hardware::PowerStageState;
using namespace unimoc::unit;
namespace sim = unimoc::hardware::sim;

constexpr float kLimitA = 50.0F;

}  // namespace

// The platform calls these directly (hot_path_interface.hpp).
bool unimoc::hardware::SampleHandler() noexcept { return CurrentControlIsr::Instance().OnSample(); }
void unimoc::hardware::ObserverHandler() noexcept { SlowUpdate::Instance().RunOnce(); }

struct sim_overcurrent_fixture {
  unimoc::settings::SettingsStore store{unimoc::test::SimTestMotorProfile(
                                            unimoc::hardware::kSettings.GetSettingsProfile()),
                                        unimoc::hardware::kSettings.GetSettingsStorage(),
                                        unimoc::settings::SettingsSaveGate::Always()};
};

namespace {

// One control cycle covers four half periods, each with its sample and control step.
void RunCycles(const unsigned count) {
  for (unsigned i = 0; i < count; ++i) {
    sim::StepCycle();
  }
}

void* Setup() {
  static sim_overcurrent_fixture fixture;
  zassert_equal(fixture.store.Load(), unimoc::settings::SettingsStatus::kFactoryDefaults);
  const auto kSnapshot = fixture.store.GetSnapshot();
  const auto& settings = kSnapshot.Get();
  zassert_equal(sim::Plant().Configure(settings), unimoc::sim::Status::kOk);
  zassert_true(unimoc::current_control::StartRuntime(settings,
                                                     unimoc::hardware::kMotors[0],
                                                     unimoc::unit::Current{kLimitA}));
  sim::SetFreeRunning(false);
  return &fixture;
}

void Before(void* /*unused*/) {
  // Flush the samples of the previous test with the stage off.
  sim::SetPhaseCurrentOverride(0.0F, 0.0F, 0.0F);
  sim::SetExternalEnable(true);
  sim::Plant().SetDcLinkVoltage(48.0_V);
  kPowerStage.Disable();
  RunCycles(1);
  kPowerStage.ClearFault();
  CurrentControlIsr::Instance().ClearTrips();
}

}  // namespace

ZTEST_F(sim_overcurrent, test_below_limit_keeps_stage_enabled) {
  zassert_true(kPowerStage.Enable());
  sim::SetPhaseCurrentOverride(40.0F, -20.0F, -20.0F);
  RunCycles(3);
  zassert_equal(kPowerStage.GetState(), PowerStageState::kEnabled);
  zassert_false(CurrentControlIsr::Instance().state.overcurrent_tripped);
}

ZTEST_F(sim_overcurrent, test_sample_check_trips_at_once_and_freezes_loop) {
  zassert_true(kPowerStage.Enable());
  sim::SetPhaseCurrentOverride(0.0F, 60.0F, -60.0F);
  RunCycles(1);
  // The per-sample check of the hardware layer, and the control step of the
  // same sample latches the trip.
  zassert_equal(kPowerStage.GetState(), PowerStageState::kFault);
  zassert_true(CurrentControlIsr::Instance().state.overcurrent_tripped);
  const auto kDuties = CurrentControlIsr::Instance().state.phase_duties;
  zassert_within(kDuties.a, 0.5_ratio, 1e-6_ratio);
  zassert_within(kDuties.b, 0.5_ratio, 1e-6_ratio);
  zassert_within(kDuties.c, 0.5_ratio, 1e-6_ratio);
  for (const auto& duties : sim::AppliedDuties()) {
    zassert_within(duties.b, 0.5_ratio, 1e-6_ratio, "neutral from the first half period on");
  }

  // The latched fault survives the current going away.
  sim::SetPhaseCurrentOverride(0.0F, 0.0F, 0.0F);
  RunCycles(2);
  zassert_false(kPowerStage.Enable());
}

ZTEST_F(sim_overcurrent, test_forced_duties_replace_the_loop_until_released) {
  CurrentControlIsr& isr = CurrentControlIsr::Instance();
  const Ratio kDutyMax = isr.svm.duty_max;
  isr.ForceDuty(0.25_ratio, 0.5_ratio, 2.0_ratio);  // phase C clamped to the SVM limit
  RunCycles(1);
  zassert_within(isr.state.phase_duties.a, 0.25_ratio, 1e-6_ratio);
  zassert_within(isr.state.phase_duties.b, 0.5_ratio, 1e-6_ratio);
  zassert_within(isr.state.phase_duties.c, kDutyMax, 1e-6_ratio);
  // From the second half period on the plant runs them.
  zassert_within(sim::AppliedDuties()[3].a, 0.25_ratio, 1e-6_ratio);

  // Released, the loop runs again: zero current and reference give neutral duties.
  isr.ReleaseForceDuty();
  RunCycles(2);
  zassert_within(isr.state.phase_duties.a, 0.5_ratio, 1e-3_ratio);
  zassert_within(isr.state.phase_duties.c, 0.5_ratio, 1e-3_ratio);
}

ZTEST_F(sim_overcurrent, test_dc_link_overvoltage_trips_and_freezes_the_loop) {
  CurrentControlIsr& isr = CurrentControlIsr::Instance();
  zassert_true(kPowerStage.Enable());
  sim::Plant().SetDcLinkVoltage(57.9_V);  // below the 58 V trip of the sim profile
  RunCycles(2);
  zassert_false(isr.state.overvoltage_tripped);
  zassert_equal(kPowerStage.GetState(), PowerStageState::kEnabled);

  sim::Plant().SetDcLinkVoltage(58.5_V);
  RunCycles(1);  // the control step of the sample latches it
  zassert_true(isr.state.overvoltage_tripped);
  zassert_true(isr.Tripped());
  zassert_equal(kPowerStage.GetState(), PowerStageState::kFault);
  zassert_within(isr.state.phase_duties.a, 0.5_ratio, 1e-6_ratio);

  sim::Plant().SetDcLinkVoltage(48.0_V);
  RunCycles(2);
  zassert_true(isr.state.overvoltage_tripped, "latched until acknowledged");
  isr.ClearTrips();
  zassert_false(isr.Tripped());
}

ZTEST_F(sim_overcurrent, test_dc_link_sample_check_trips_in_the_step_of_the_sample) {
  CurrentControlIsr& isr = CurrentControlIsr::Instance();
  zassert_true(kPowerStage.Enable());
  sim::Plant().SetDcLinkVoltage(58.5_V);
  RunCycles(1);
  // The per-sample check of the hardware layer trips the stage; the control
  // step of the same sample latches the trip.
  zassert_equal(kPowerStage.GetState(), PowerStageState::kFault);
  zassert_true(isr.state.overvoltage_tripped);
  zassert_false(isr.state.overcurrent_tripped);
  zexpect_str_equal(isr.TripName(), "DC-link overvoltage trip");
  sim::Plant().SetDcLinkVoltage(48.0_V);
}

ZTEST_F(sim_overcurrent, test_startup_needs_external_enable) {
  sim::SetExternalEnable(false);
  unimoc::startup::HwStartup startup{CurrentControlIsr::Instance(), fixture->store.GetOperations()};
  zassert_equal(startup.RequestRun(), unimoc::startup::StartupStart::kNotReleased);
  zassert_equal(startup.State(), unimoc::startup::FsmState::kIdle);
  zassert_not_equal(kPowerStage.GetState(), PowerStageState::kEnabled);
}

ZTEST_F(sim_overcurrent, test_startup_run_releases_stage_and_fault_cuts_it) {
  unimoc::startup::HwStartup startup{CurrentControlIsr::Instance(), fixture->store.GetOperations()};
  zassert_equal(startup.RequestRun(), unimoc::startup::StartupStart::kStarted);
  zassert_equal(startup.State(), unimoc::startup::FsmState::kPwmDisable);
  zassert_equal(kPowerStage.GetState(), PowerStageState::kEnabled);

  sim::SetPhaseCurrentOverride(70.0F, -35.0F, -35.0F);
  RunCycles(1);  // trip at the sample, samples_ready for the startup FSM at the end of the cycle
  startup.RunOnce();
  zassert_equal(startup.State(), unimoc::startup::FsmState::kFault);
  zassert_not_equal(kPowerStage.GetState(), PowerStageState::kEnabled);
  zexpect_equal(startup.Status().fault,
                unimoc::startup::StartupFault::kTrip,
                "the hardware trip opened the stage");
}

namespace {

/// One sample for the startup FSM: phase currents a ± noise, b ± noise (alternating sign), c balancing.
void StartupSample(unimoc::startup::HwStartup& startup,
                   const float a,
                   const float b,
                   const float noise,
                   const unsigned index) {
  const float kNoise = (index % 2U == 0U) ? noise : -noise;
  sim::SetPhaseCurrentOverride(a + kNoise, b + kNoise, -(a + b) - (2.0F * kNoise));
  RunCycles(1);
  startup.RunOnce();
}

/// Runs @p samples samples of one step, then advances to the next step.
void StartupStep(unimoc::startup::HwStartup& startup,
                 const unsigned samples,
                 const float a,
                 const float b,
                 const float noise,
                 const bool motor_connected = false) {
  for (unsigned i = 0U; i < samples; ++i) {
    StartupSample(startup, a, b, noise, i);
  }
  // The step has measured: the continue is taken (a continue while measuring is refused).
  zassert_equal(startup.RequestNextStep(motor_connected), unimoc::startup::StartupContinue::kAccepted);
  StartupSample(startup, a, b, noise, samples);
}

}  // namespace

ZTEST_F(sim_overcurrent, test_startup_results_are_in_units) {
  using unimoc::startup::FsmState;
  using unimoc::startup::HwStartup;
  CurrentControlIsr& isr = CurrentControlIsr::Instance();
  const uint32_t kTriggerOffset = isr.state.adc_trigger_offset;
  HwStartup startup{isr, fixture->store.GetOperations()};
  startup.RequestRun();
  zassert_equal(startup.State(), FsmState::kPwmDisable);

  // Phase 1 without a motor: a zero offset of 0.2 A and -0.1 A with 10 mA noise.
  StartupStep(startup, 1U, 0.2F, -0.1F, 0.01F);
  zassert_equal(startup.State(), FsmState::kAdcOffsetCal);
  StartupStep(startup, HwStartup::kNCal, 0.2F, -0.1F, 0.01F);
  UNIMOC_EXPECT_NEAR(startup.results.adc_offset_a, 0.2_A, 1e-5_A);
  UNIMOC_EXPECT_NEAR(startup.results.adc_offset_b, -0.1_A, 1e-5_A);
  UNIMOC_EXPECT_NEAR(startup.results.adc_offset_c, -0.1_A, 1e-5_A);
  zexpect_true(startup.results.passed[static_cast<uint8_t>(FsmState::kAdcOffsetCal)]);
  StartupStep(startup, HwStartup::kNCal, 0.2F, -0.1F, 0.01F);
  UNIMOC_EXPECT_NEAR(startup.results.adc_noise_rms_a, 0.01_A, 1e-5_A);
  UNIMOC_EXPECT_NEAR(startup.results.adc_noise_rms_b, 0.01_A, 1e-5_A);
  zexpect_true(startup.results.passed[static_cast<uint8_t>(FsmState::kAdcNoiseFloor)]);
  for (unsigned i = 0U; i < 3U; ++i) {  // DUTY_FORCE_LOW .. HIGH
    StartupStep(startup, HwStartup::kHoldSamples + 1U, 0.2F, -0.1F, 0.01F);
  }
  zassert_equal(startup.State(), FsmState::kDcLinkVoltageCheck);
  startup.SetExtVdc(48.0_V);  // the sim DC link
  StartupStep(startup, HwStartup::kNCal, 0.2F, -0.1F, 0.01F);
  UNIMOC_EXPECT_NEAR(startup.results.gain_vdc, 1.0_ratio, 1e-3_ratio);
  zexpect_true(startup.results.passed[static_cast<uint8_t>(FsmState::kDcLinkVoltageCheck)]);
  StartupStep(startup, 2U * 512U, 0.2F, -0.1F, 0.01F);  // GATE_DRIVER_ENABLE_CHECK
  zassert_equal(startup.State(), FsmState::kConnectMotor);
  StartupSample(startup, 0.0F, 0.0F, 0.0F, 0U);  // the barrier runs once: outputs off, waits
  zexpect_equal(startup.RequestNextStep(false), unimoc::startup::StartupContinue::kNeedsConfirmation);
  StartupStep(startup, 1U, 0.0F, 0.0F, 0.0F, true);
  zassert_equal(startup.State(), FsmState::kPhaseAdcAlignment);

  // Phase 2: 2 A through phase A with the same noise. The RMS of each sweep
  // position needs the double accumulators: in float the 2 A would bury it.
  StartupStep(startup, (HwStartup::kNSweepSteps * HwStartup::kNAlignSamples) + 1U, 2.0F, -1.0F, 0.01F);
  zexpect_true(startup.results.passed[static_cast<uint8_t>(FsmState::kPhaseAdcAlignment)]);
  zassert_equal(startup.State(), FsmState::kCurrentSenseCalibration);

  // 1 A on alpha (phase B carries -0.5 A) as read by the ADC, with the zero
  // offset of 0.2 A and -0.1 A: 0.8 A flows; the clamp meter reads 1.25 A.
  startup.SetExtCurrent(1.25_A);
  for (unsigned i = 0U; i < HwStartup::kNCal; ++i) {
    StartupSample(startup, 1.0F, -0.5F, 0.01F, i);
  }
  // The samples reach the control cycle one cycle late: the first one of the
  // step is still the last one of the alignment (1/1024 of 1 A off).
  UNIMOC_EXPECT_NEAR(startup.results.gain_a, 0.64_ratio, 1e-3_ratio);
  UNIMOC_EXPECT_NEAR(startup.results.gain_b, 0.64_ratio, 1e-3_ratio);
  UNIMOC_EXPECT_NEAR(startup.results.gain_c, 0.64_ratio, 1e-3_ratio);
  zexpect_false(startup.results.passed[static_cast<uint8_t>(FsmState::kCurrentSenseCalibration)],
                "36 %% gain error");
  zassert_equal(kPowerStage.GetState(), PowerStageState::kEnabled);

  // The last step ends in DONE: calibration committed, outputs off.
  StartupStep(startup, 0U, 0.0F, 0.0F, 0.0F);
  zassert_equal(startup.State(), FsmState::kDone);
  zexpect_false(startup.IsActive());
  zexpect_not_equal(kPowerStage.GetState(), PowerStageState::kEnabled);
  {
    const auto kSnapshot = fixture->store.GetSnapshot();
    const auto& settings = kSnapshot.Get();
    UNIMOC_EXPECT_FLOAT_EQ(settings.adc_offset_a, startup.results.adc_offset_a);
    UNIMOC_EXPECT_FLOAT_EQ(settings.adc_offset_b, startup.results.adc_offset_b);
    UNIMOC_EXPECT_FLOAT_EQ(settings.adc_gain_a, 1.0_ratio / startup.results.gain_a);
    UNIMOC_EXPECT_FLOAT_EQ(settings.adc_gain_b, 1.0_ratio / startup.results.gain_b);
    UNIMOC_EXPECT_FLOAT_EQ(settings.adc_offset_c, startup.results.adc_offset_c);
    UNIMOC_EXPECT_FLOAT_EQ(settings.adc_gain_c, 1.0_ratio / startup.results.gain_c);
    UNIMOC_EXPECT_FLOAT_EQ(settings.adc_gain_vdc, 1.0_ratio / startup.results.gain_vdc);
  }

  isr.SetAdcTriggerOffset(kTriggerOffset);  // the sweep moved it
  zassert_equal(fixture->store.GetOperations().ApplyAdcCalibration(unimoc::settings::AdcCalibration{}),
                unimoc::settings::SettingsStatus::kSuccess);
}

ZTEST_SUITE(sim_overcurrent, nullptr, Setup, Before, nullptr, nullptr);
```
