## tests/twister/sim_closed_loop/testcase.yaml
```yaml
tests:
  unimoc.sim.closed_loop:
    platform_allow: native_sim/native/64
    tags: unimoc sim
```

## tests/twister/sim_irq_cadence/testcase.yaml
```yaml
tests:
  unimoc.sim.irq_cadence:
    platform_allow: native_sim/native/64
    tags: unimoc sim
```

## tests/twister/sim_overcurrent/testcase.yaml
```yaml
tests:
  unimoc.sim.overcurrent:
    platform_allow: native_sim/native/64
    tags: unimoc sim
```

## zephyr/Kconfig
```kconfig
# SPDX-License-Identifier: GPL-3.0-or-later
#
# UNIMOC as a Zephyr module (zephyr/module.yml).

config UNIMOC
	bool "UNIMOC motor-control libraries"
	depends on CPP
	select REQUIRES_FULL_LIBCPP
	help
	  Provides the portable UNIMOC libraries as CMake interface targets:
	  unimoc_lib (units, settings, cyphal, motor_control) and unimoc_sim
	  (motor plant simulation, native_sim). Applications and tests link
	  them. Requires CONFIG_STD_CPP20=y.

if UNIMOC

choice UNIMOC_PLATFORM
	prompt "UNIMOC hardware platform"
	default UNIMOC_PLATFORM_BCC if BOARD_BCC
	default UNIMOC_PLATFORM_SIM if BOARD_NATIVE_SIM
	help
	  Selects which hardware layer (hardware/zephyr_*) the application
	  compiles. The choice follows the board; it is never a preprocessor
	  switch.

config UNIMOC_PLATFORM_BCC
	bool "Battery case controller (STM32G473)"
	depends on BOARD_BCC

config UNIMOC_PLATFORM_SIM
	bool "Simulation on native_sim"
	depends on BOARD_NATIVE_SIM

endchoice

config UNIMOC_SETTINGS_ZMS
	bool "Persist settings with the Zephyr settings subsystem on ZMS"
	default y
	depends on UNIMOC_PLATFORM_BCC || UNIMOC_PLATFORM_SIM
	select FLASH
	select FLASH_MAP
	select ZMS
	select SETTINGS
	help
	  Registers that differ from the factory profile are stored one entry
	  each in the storage partition (hardware/zephyr_common/
	  zephyr_settings_storage.cpp). Needs the 'storage_partition' of the
	  board devicetree; native_sim uses its flash simulator.

config UNIMOC_TRACE_BUFFER_BYTES
	int "cymon capture buffer [bytes]"
	default 8192
	range 64 262140
	help
	  Size of the RAM ring buffer of the cymon traces (lib/cymon,
	  CYMON_MAX_BUFFER_BYTES). It is split across the channels of one
	  capture; the trace device is a static object of about this size
	  plus 24 bytes per variable.

config UNIMOC_TRACE_VARS
	int "cymon trace variables"
	default 32
	range 1 255
	help
	  Number of float signals the firmware can offer for traces
	  (CYMON_MAX_VARS).

config UNIMOC_TRACE_CHANNELS
	int "cymon channels of one capture"
	default 8
	range 1 16
	help
	  Number of signals one capture records at the same time
	  (CYMON_MAX_CHANNELS); at most UNIMOC_TRACE_VARS.

config UNIMOC_CONTROL_THREAD_PRIORITY
	int "Priority of the control thread"
	default 2
	help
	  The control thread runs the outer loop (speed and position control,
	  setpoint limiting) at 2 kHz, woken by the observer interrupt. It
	  must preempt the Cyphal thread: it reads the setpoints the Cyphal
	  thread hands over through a mailbox.

config UNIMOC_CONTROL_THREAD_STACK_SIZE
	int "Stack size of the control thread"
	default 2048

config UNIMOC_CYPHAL
	bool "Cyphal/CAN node of the drive"
	depends on UNIMOC_PLATFORM_BCC || UNIMOC_PLATFORM_SIM
	select CAN
	select HWINFO
	select REBOOT
	help
	  Runs the Cyphal node of the drive in a Zephyr thread
	  (hardware/zephyr_common/cyphal_runtime.cpp): heartbeat, GetInfo,
	  registers on the settings store, ExecuteCommand, plug-and-play,
	  readiness and setpoints, telemetry and the log as
	  uavcan.diagnostic.Record. The CAN interface is the chosen
	  zephyr,canbus; native_sim adds a serial-line CAN interface.

if UNIMOC_CYPHAL

config UNIMOC_CYPHAL_CAN_FD
	bool "Use CAN FD frames"
	default y
	select CAN_FD_MODE
	help
	  Sends Cyphal/CAN with 64 byte CAN FD frames when the controller
	  supports it, otherwise classic 8 byte frames.

config UNIMOC_CYPHAL_CAN_BRS
	bool "Bit rate switch in CAN FD frames"
	default y
	depends on UNIMOC_CYPHAL_CAN_FD
	help
	  Sets BRS in sent CAN FD frames: the data phase uses the data bit
	  rate of the controller (bitrate-data in the devicetree). Without a
	  higher data bit rate it has no effect.

config UNIMOC_CYPHAL_THREAD_PRIORITY
	int "Priority of the Cyphal thread"
	default 5

config UNIMOC_CYPHAL_THREAD_STACK_SIZE
	int "Stack size of the Cyphal thread"
	default 8192

config UNIMOC_CYPHAL_ARENA_SIZE
	int "Memory arena of libcanard [bytes]"
	default 24576
	help
	  O1Heap arena for the TX queues, the RX sessions and multi-frame
	  transfers.

config UNIMOC_CYPHAL_LOG_BACKEND
	bool "Log as uavcan.diagnostic.Record"
	default y
	depends on LOG
	help
	  A Zephyr log backend hands the log lines to the Cyphal thread,
	  which publishes them on the bus.

config UNIMOC_CYPHAL_LOG_LEVEL
	int "Highest log level sent over Cyphal"
	default 3
	range 1 4
	depends on UNIMOC_CYPHAL_LOG_BACKEND
	help
	  1 error, 2 warning, 3 info, 4 debug.

config UNIMOC_CYPHAL_SLCAN
	bool "Serial-line CAN interface on pseudo terminals (native_sim)"
	default y
	depends on UNIMOC_PLATFORM_SIM
	select SERIAL
	select UART_INTERRUPT_DRIVEN
	help
	  A second CAN interface of the simulated drive in the Lawicel
	  (slcan) ASCII protocol on the pseudo terminals listed in the
	  slcan-uarts property of zephyr,user, with classic 8 byte frames.
	  One tool process per terminal; the terminals form one bus. It lets
	  pycyphal and yakut reach the simulation without SocketCAN (WSL2
	  kernels without vcan): UAVCAN__CAN__IFACE="slcan:/dev/pts/<n>",
	  UAVCAN__CAN__MTU=8, UAVCAN__CAN__BITRATE="1000000 1000000".

endif # UNIMOC_CYPHAL

module = UNIMOC
module-str = UNIMOC
source "subsys/logging/Kconfig.template.log_config"

endif # UNIMOC
```
